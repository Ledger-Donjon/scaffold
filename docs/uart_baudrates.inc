+----------+---------+--------------------+---------+
| Baudrate | Divisor | Effective baudrate |   Error |
+==========+=========+====================+=========+
|     1200 |   83332 |           1200.005 | 0.000 % |
+----------+---------+--------------------+---------+
|     2400 |   41665 |           2400.038 | 0.002 % |
+----------+---------+--------------------+---------+
|     4800 |   20832 |           4800.077 | 0.002 % |
+----------+---------+--------------------+---------+
|     9600 |   10415 |           9600.614 | 0.006 % |
+----------+---------+--------------------+---------+
|    19200 |    5207 |          19201.229 | 0.006 % |
+----------+---------+--------------------+---------+
|    38400 |    2603 |          38402.458 | 0.006 % |
+----------+---------+--------------------+---------+
|    57600 |    1735 |          57603.687 | 0.006 % |
+----------+---------+--------------------+---------+
|   115200 |     867 |         115207.373 | 0.006 % |
+----------+---------+--------------------+---------+
|  1000000 |      99 |        1000000.000 | 0.000 % |
+----------+---------+--------------------+---------+
|  2000000 |      49 |        2000000.000 | 0.000 % |
+----------+---------+--------------------+---------+
